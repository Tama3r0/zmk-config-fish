## config/west.yml
```yaml
manifest:
  remotes:
    - name: zmkfirmware
      url-base: https://github.com/zmkfirmware
  projects:
    - name: zmk
      remote: zmkfirmware
      revision: v0.3
      import: app/west.yml
  self:
    path: config
manifest:
  remotes:
    - name: 4mplelab
      url-base: https://github.com/4mplelab
  projects:
    - name: zmk-feature-charge-indicator
      remote: 4mplelab
      revision: main
  self:
    path: config
```
